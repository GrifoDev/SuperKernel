## drivers/cpufreq/Kconfig
```kconfig
menu "CPU Frequency scaling"

config CPU_FREQ
	bool "CPU Frequency scaling"
	help
	  CPU Frequency scaling allows you to change the clock speed of 
	  CPUs on the fly. This is a nice method to save power, because 
	  the lower the CPU clock speed, the less power the CPU consumes.

	  Note that this driver doesn't automatically change the CPU
	  clock speed, you need to either enable a dynamic cpufreq governor
	  (see below) after boot, or use a userspace tool.

	  For details, take a look at <file:Documentation/cpu-freq>.

	  If in doubt, say N.

if CPU_FREQ

config CPU_FREQ_GOV_COMMON
	bool

config CPU_FREQ_BOOST_SW
	bool
	depends on THERMAL

config CPU_FREQ_STAT
	tristate "CPU frequency translation statistics"
	default y
	help
	  This driver exports CPU frequency statistics information through sysfs
	  file system.

	  To compile this driver as a module, choose M here: the
	  module will be called cpufreq_stats.

	  If in doubt, say N.

config CPU_FREQ_STAT_DETAILS
	bool "CPU frequency translation statistics details"
	depends on CPU_FREQ_STAT
	help
	  This will show detail CPU frequency translation table in sysfs file
	  system.

	  If in doubt, say N.

choice
	prompt "Default CPUFreq governor"
	default CPU_FREQ_DEFAULT_GOV_USERSPACE if ARM_SA1100_CPUFREQ || ARM_SA1110_CPUFREQ
	default CPU_FREQ_DEFAULT_GOV_PERFORMANCE
	help
	  This option sets which CPUFreq governor shall be loaded at
	  startup. If in doubt, select 'performance'.

config CPU_FREQ_DEFAULT_GOV_PERFORMANCE
	bool "performance"
	select CPU_FREQ_GOV_PERFORMANCE
	help
	  Use the CPUFreq governor 'performance' as default. This sets
	  the frequency statically to the highest frequency supported by
	  the CPU.

config CPU_FREQ_DEFAULT_GOV_POWERSAVE
	bool "powersave"
	depends on EXPERT
	select CPU_FREQ_GOV_POWERSAVE
	help
	  Use the CPUFreq governor 'powersave' as default. This sets
	  the frequency statically to the lowest frequency supported by
	  the CPU.

config CPU_FREQ_DEFAULT_GOV_USERSPACE
	bool "userspace"
	select CPU_FREQ_GOV_USERSPACE
	help
	  Use the CPUFreq governor 'userspace' as default. This allows
	  you to set the CPU frequency manually or when a userspace 
	  program shall be able to set the CPU dynamically without having
	  to enable the userspace governor manually.

config CPU_FREQ_DEFAULT_GOV_ONDEMAND
	bool "ondemand"
	select CPU_FREQ_GOV_ONDEMAND
	select CPU_FREQ_GOV_PERFORMANCE
	help
	  Use the CPUFreq governor 'ondemand' as default. This allows
	  you to get a full dynamic frequency capable system by simply
	  loading your cpufreq low-level hardware driver.
	  Be aware that not all cpufreq drivers support the ondemand
	  governor. If unsure have a look at the help section of the
	  driver. Fallback governor will be the performance governor.

config CPU_FREQ_DEFAULT_GOV_CONSERVATIVE
	bool "conservative"
	select CPU_FREQ_GOV_CONSERVATIVE
	select CPU_FREQ_GOV_PERFORMANCE
	help
	  Use the CPUFreq governor 'conservative' as default. This allows
	  you to get a full dynamic frequency capable system by simply
	  loading your cpufreq low-level hardware driver.
	  Be aware that not all cpufreq drivers support the conservative
	  governor. If unsure have a look at the help section of the
	  driver. Fallback governor will be the performance governor.

config CPU_FREQ_DEFAULT_GOV_INTERACTIVE
	bool "interactive"
	select CPU_FREQ_GOV_INTERACTIVE
	help
	  Use the CPUFreq governor 'interactive' as default. This allows
	  you to get a full dynamic cpu frequency capable system by simply
	  loading your cpufreq low-level hardware driver, using the
	  'interactive' governor for latency-sensitive workloads.

config CPU_FREQ_DEFAULT_GOV_ZZMOOVE
	bool "zzmoove"
	select CPU_FREQ_GOV_ZZMOOVE
	select CPU_FREQ_GOV_PERFORMANCE
	help
	  Use the CPUFreq governor 'zzmoove' as default, using predefined
	  frequency lookup tables and optimized scaling triggers instead of
	  % frequency steps to get smooth up/downscaling dependant on CPU load.

config CPU_FREQ_DEFAULT_GOV_IMPULSE
	bool "impulse"
	depends on SCHED_FREQ_INPUT
	select CPU_FREQ_GOV_IMPULSE
	help
	  Use the CPUFreq governor 'impulse' as default. This allows
	  you to get a full dynamic cpu frequency capable system by simply
	  loading your cpufreq low-level hardware driver, using the
	  'impulse' governor for latency-sensitive workloads.

config CPU_FREQ_DEFAULT_GOV_BARRY_ALLEN
	bool "barry_allen"
	select CPU_FREQ_GOV_BARRY_ALLEN
	help
	  Use the CPUFreq governor 'barry_allen' as default. This allows
	  you to get a full dynamic cpu frequency capable system by simply
	  loading your cpufreq low-level hardware driver, using the
	  'barry_allen' governor for latency-sensitive workloads.

config CPU_FREQ_DEFAULT_GOV_NIGHTMARE
	bool "nightmare"
	select CPU_FREQ_GOV_NIGHTMARE
	help
	  Use the CPUFreq governor 'Nightmare' as default.

config CPU_FREQ_DEFAULT_GOV_DARKNESS
	bool "darkness"
	select CPU_FREQ_GOV_DARKNESS
	help
	  Use the CPUFreq governor 'Darkness' as default.

config CPU_FREQ_DEFAULT_GOV_PEGASUSQ
	bool "pegasusq"
	select CPU_FREQ_GOV_PEGASUSQ
	help
	  Use the CPUFreq governor 'pegasusq' as default.

config CPU_FREQ_DEFAULT_GOV_YANKACTIVE
	bool "yankactive"
	select CPU_FREQ_GOV_YANKACTIVE
	help
	  Use the CPUFreq governor 'yankactive' as default. This allows
	  you to get a full dynamic cpu frequency capable system by simply
	  loading your cpufreq low-level hardware driver, using the
	  'yankactive' governor for latency-sensitive workloads.

config CPU_FREQ_DEFAULT_GOV_INTELLIACTIVE
	bool "intelliactive"
	select CPU_FREQ_GOV_INTELLIACTIVE
	help
	  Use the CPUFreq governor 'intelliactive' as default. This allows
	  you to get a full dynamic cpu frequency capable system by simply
	  loading your cpufreq low-level hardware driver, using the
	  'interactive' governor for latency-sensitive workloads.

config CPU_FREQ_DEFAULT_GOV_ONDEMANDPLUS
	bool "ondemandplus"
	select CPU_FREQ_GOV_ONDEMANDPLUS
	select CPU_FREQ_GOV_PERFORMANCE
	help
	  Use the CPUFreq governor 'ondemandplus' as default. This allows
	  you to get a full dynamic frequency capable system by simply
	  loading your cpufreq low-level hardware driver.
	  Be aware that not all cpufreq drivers support the ondemandplus
	  governor. If unsure have a look at the help section of the
	  driver. Fallback governor will be the performance governor.

config CPU_FREQ_DEFAULT_GOV_INTERACTIVE_PRO
	bool "interactive_pro"
	depends on SCHED_FREQ_INPUT
	select CPU_FREQ_GOV_INTERACTIVE_PRO
	help
	  Use the CPUFreq governor 'interactive_pro' as default.

config CPU_FREQ_DEFAULT_GOV_INTELLIMM
       bool "intelliminmax"
       select CPU_FREQ_GOV_INTELLIMM
       help
         Use the CPUFreq governor 'intelliminmax' as default. This is
         governor will use only 3 different frequencies, idle, UI and max

config CPU_FREQ_DEFAULT_GOV_BIOSHOCK
	bool "BioShock"
	select CPU_FREQ_GOV_BIOSHOCK
	help
	  Default governor of BioShock kernel

config CPU_FREQ_DEFAULT_GOV_LIONHEART
	bool "lionheart"
	select CPU_FREQ_GOV_LIONHEART
	help
	  Use the CPUFreq governor 'lionheart' as default.

config CPU_FREQ_DEFAULT_GOV_SMARTMAX
	bool "smartmax"
	select CPU_FREQ_GOV_SMARTMAX
	help
	  Use the CPUFreq governor 'smartmax' as default.

config CPU_FREQ_DEFAULT_GOV_SMARTASS2
	bool "smartassV2"
	select CPU_FREQ_GOV_SMARTASS2
	help
	  Use the CPUFreq governor 'smartass2' as default.

config CPU_FREQ_DEFAULT_GOV_IRONACTIVE
	bool "ironactive"
	depends on SCHED_FREQ_INPUT
	select CPU_FREQ_GOV_IRONACTIVE
	help
	  Use the CPUFreq governor 'ironactive' as default. This cpugovernor
	  is based on the 'interactive' governor with many changes made by
	  CAF.

config CPU_FREQ_DEFAULT_GOV_SMARTMAX_EPS
	bool "smartmax_eps"
	select CPU_FREQ_GOV_SMARTMAX_EPS
	help
	  Use the CPUFreq governor 'smartmax eps' as default

config CPU_FREQ_DEFAULT_GOV_ALUCARD
	bool "alucard"
	select CPU_FREQ_GOV_ALUCARD
	help

config CPU_FREQ_DEFAULT_GOV_BLU_ACTIVE
	bool "blu_active"
	select CPU_FREQ_GOV_BLU_ACTIVE
	help
	  Use the CPUFreq governor 'blu_active' as default. This allows
	  you to get a full dynamic cpu frequency capable system by simply
	  loading your cpufreq low-level hardware driver, using the
	  'interactive' governor for latency-sensitive workloads.

config CPU_FREQ_DEFAULT_GOV_CAFACTIVE
	bool "cafactive"
	select CPU_FREQ_GOV_CAFACTIVE
	help
	  Use the CPUFreq governor 'cafactive' as default. This allows
	  you to get a full dynamic cpu frequency capable system by simply
	  loading your cpufreq low-level hardware driver, using the
	  'cafactive' governor for latency-sensitive workloads.

config CPU_FREQ_DEFAULT_GOV_ELECTRODEMAND
	bool "electrodemand"
	select CPU_FREQ_GOV_ELECTRODEMAND
        select CPU_FREQ_GOV_PERFORMANCE
	help
	  Use the CPUFreq governor 'electrodemand' as default. This allows
	  you to get a full dynamic cpu frequency capable system by simply
	  loading your cpufreq low-level hardware driver, using the
	  'electrodemand' governor for latency-sensitive workloads.

config CPU_FREQ_DEFAULT_GOV_ONDEMAND_X
	bool "ondemand_x"
	select CPU_FREQ_GOV_ONDEMAND_X
	select CPU_FREQ_GOV_PERFORMANCE
	help
	  Use the CPUFreq governor 'ondemand_x' as default. This allows
	  you to get a full dynamic frequency capable system by simply
	  loading your cpufreq low-level hardware driver.
	  Be aware that not all cpufreq drivers support the ondemand_x
	  governor. If unsure have a look at the help section of the
	  driver. Fallback governor will be the performance governor.

config CPU_FREQ_DEFAULT_GOV_HYPER
	bool "HYPER"
	select CPU_FREQ_GOV_HYPER
	---help---
	  Use the CPUFreq governor 'HYPER' as default.

config CPU_FREQ_DEFAULT_GOV_INTELLIDEMAND
	bool "intellidemand"
	select CPU_FREQ_GOV_INTELLIDEMAND
	help
	  Use the CPUFreq governor 'intellidemand' as default. This is
	  based on Ondemand with browsing detection based on GPU loading

config CPU_FREQ_DEFAULT_GOV_DESPAIR
	bool "despair"
	depends on TOUCHBOOST
	select CPU_FREQ_GOV_DESPAIR
	help

config CPU_FREQ_DEFAULT_GOV_HELLSACTIVE
	bool "hellsactive"
	depends on TOUCHBOOST
	select CPU_FREQ_GOV_HELLSACTIVE
	help
	  Use the CPUFreq governor 'hellsactive' as default. This allows
	  you to get a full dynamic cpu frequency capable system by simply
	  loading your cpufreq low-level hardware driver, using the
	  'interactive' governor for latency-sensitive workloads.

config CPU_FREQ_DEFAULT_GOV_INTERACTIVE_X
	bool "interactive_x"
	depends on TOUCHBOOST
	select CPU_FREQ_GOV_INTERACTIVE_X
	help
	  Use the CPUFreq governor 'interactive_x' as default. This allows
	  you to get a full dynamic cpu frequency capable system by simply
	  loading your cpufreq low-level hardware driver, using the
	  'interactive' governor for latency-sensitive workloads.

config CPU_FREQ_DEFAULT_GOV_CONSERVATIVE_X
	bool "conservative_x"
	depends on TOUCHBOOST
	select CPU_FREQ_GOV_CONSERVATIVE_X
	select CPU_FREQ_GOV_PERFORMANCE
	help
	  Use the CPUFreq governor 'conservative_x' as default. This allows
	  you to get a full dynamic frequency capable system by simply
	  loading your cpufreq low-level hardware driver.
	  Be aware that not all cpufreq drivers support the conservative
	  governor. If unsure have a look at the help section of the
	  driver. Fallback governor will be the performance governor.

config CPU_FREQ_DEFAULT_GOV_INTEREXTREM
	bool "interextrem"
	select CPU_FREQ_GOV_INTEREXTREM
	help
	  Use the CPUFreq governor 'interextrem' as default. This
	  is a tweaked 'interactive' CPUFreq governor, This allows
	  you to get a full dynamic cpu frequency capable system by simply
	  loading your cpufreq low-level hardware driver, using the
	  'interactive' governor for latency-sensitive workloads.
endchoice

config CPU_FREQ_GOV_PERFORMANCE
	tristate "'performance' governor"
	help
	  This cpufreq governor sets the frequency statically to the
	  highest available CPU frequency.

	  To compile this driver as a module, choose M here: the
	  module will be called cpufreq_performance.

	  If in doubt, say Y.

config CPU_FREQ_GOV_POWERSAVE
	tristate "'powersave' governor"
	help
	  This cpufreq governor sets the frequency statically to the
	  lowest available CPU frequency.

	  To compile this driver as a module, choose M here: the
	  module will be called cpufreq_powersave.

	  If in doubt, say Y.

config CPU_FREQ_GOV_USERSPACE
	tristate "'userspace' governor for userspace frequency scaling"
	help
	  Enable this cpufreq governor when you either want to set the
	  CPU frequency manually or when a userspace program shall
	  be able to set the CPU dynamically, like on LART 
	  <http://www.lartmaker.nl/>.

	  To compile this driver as a module, choose M here: the
	  module will be called cpufreq_userspace.

	  For details, take a look at <file:Documentation/cpu-freq/>.

	  If in doubt, say Y.

config CPU_FREQ_GOV_ONDEMAND
	tristate "'ondemand' cpufreq policy governor"
	select CPU_FREQ_GOV_COMMON
	help
	  'ondemand' - This driver adds a dynamic cpufreq policy governor.
	  The governor does a periodic polling and 
	  changes frequency based on the CPU utilization.
	  The support for this governor depends on CPU capability to
	  do fast frequency switching (i.e, very low latency frequency
	  transitions). 

	  To compile this driver as a module, choose M here: the
	  module will be called cpufreq_ondemand.

	  For details, take a look at linux/Documentation/cpu-freq.

	  If in doubt, say N.

config CPU_FREQ_GOV_INTERACTIVE
	tristate "'interactive' cpufreq policy governor"
	help
	  'interactive' - This driver adds a dynamic cpufreq policy governor
	  designed for latency-sensitive workloads.

	  This governor attempts to reduce the latency of clock
	  increases so that the system is more responsive to
	  interactive workloads.

	  To compile this driver as a module, choose M here: the
	  module will be called cpufreq_interactive.

	  For details, take a look at linux/Documentation/cpu-freq.

	  If in doubt, say N.

config MODE_AUTO_CHANGE
	bool "automatic governor parameter change"
	depends on CPU_FREQ_GOV_INTERACTIVE || CPU_FREQ_GOV_INTEREXTREM
	default n
	help
	  automatic governor parameter change by MODE

config CPU_FREQ_GOV_CONSERVATIVE
	tristate "'conservative' cpufreq governor"
	depends on CPU_FREQ
	select CPU_FREQ_GOV_COMMON
	help
	  'conservative' - this driver is rather similar to the 'ondemand'
	  governor both in its source code and its purpose, the difference is
	  its optimisation for better suitability in a battery powered
	  environment.  The frequency is gracefully increased and decreased
	  rather than jumping to 100% when speed is required.

	  If you have a desktop machine then you should really be considering
	  the 'ondemand' governor instead, however if you are using a laptop,
	  PDA or even an AMD64 based computer (due to the unacceptable
	  step-by-step latency issues between the minimum and maximum frequency
	  transitions in the CPU) you will probably want to use this governor.

	  To compile this driver as a module, choose M here: the
	  module will be called cpufreq_conservative.

	  For details, take a look at linux/Documentation/cpu-freq.

	  If in doubt, say N.

config CPU_FREQ_GOV_ZZMOOVE
	tristate "'zzmoove' cpufreq governor"
	depends on CPU_FREQ
	help
	  'zzmoove' - based on cpufreq_conservative, using predefined
	  frequency lookup tables and optimized scaling triggers instead of
	  % frequency steps to get smooth up/downscaling dependant on CPU load.
	  If in doubt, say N.

config CPU_FREQ_GOV_IMPULSE
	tristate "'interactive' cpufreq policy governor"
	depends on SCHED_FREQ_INPUT
	help
	  'impulse' - This driver adds a dynamic cpufreq policy governor
	  designed for latency-sensitive workloads.

	  If in doubt, say N.

config CPU_FREQ_GOV_BARRY_ALLEN
	tristate "'barry_allen' cpufreq policy governor"
	help
	  'barry_allen' - This driver adds a dynamic cpufreq policy governor
	  designed for latency-sensitive workloads.

	  This governor attempts to reduce the latency of clock
	  increases so that the system is more responsive to
	  barry_allen workloads.

	  To compile this driver as a module, choose M here: the
	  module will be called cpufreq_barry_allen.

	  For details, take a look at linux/Documentation/cpu-freq.

	  If in doubt, say N.

config CPU_FREQ_GOV_NIGHTMARE
	tristate "'nightmare' cpufreq governor"
	depends on CPU_FREQ

config CPU_FREQ_GOV_DARKNESS
	tristate "'darkness' cpufreq governor"
	depends on CPU_FREQ

config CPU_FREQ_GOV_PEGASUSQ
	tristate "'pegasusq' cpufreq policy governor"

config CPU_FREQ_GOV_YANKACTIVE
	tristate "'yankactive' cpufreq policy governor"
	help
	  'yankactive' - This driver adds a dynamic cpufreq policy governor
	  designed for latency-sensitive workloads.

	  The governor is based on interactive with just different default settings
	  and can be achieved using interactive with a script. This is added for
	  simplification purposes for myself.

config CPU_FREQ_GOV_INTELLIACTIVE
	tristate "'intelliactive' cpufreq policy governor"
	help
	  'intelliactive' - This driver adds a dynamic cpufreq policy governor
	  designed for latency-sensitive workloads.

	  This governor attempts to reduce the latency of clock
	  increases so that the system is more responsive to
	  interactive workloads.

	  To compile this driver as a module, choose M here: the
	  module will be called cpufreq_interactive.

	  For details, take a look at linux/Documentation/cpu-freq.

	  If in doubt, say N.

config CPU_FREQ_GOV_ONDEMANDPLUS
	tristate "'ondemandplus' cpufreq policy governor"
	help
	  'ondemandplus' - This driver adds a dynamic cpufreq policy
	  governor. The governor does a periodic polling and
	  changes frequency based on the CPU utilization.
	  The support for this governor depends on CPU capability to
	  do fast frequency switching (i.e, very low latency frequency
	  transitions).
	  To compile this driver as a module, choose M here: the
	  module will be called cpufreq_ondemandplus.
	  For details, take a look at linux/Documentation/cpu-freq.
	  If in doubt, say N.

config CPU_FREQ_GOV_INTERACTIVE_PRO
	tristate "'interactive_pro' cpufreq governor"
	depends on SCHED_FREQ_INPUT
	depends on CPU_FREQ

config CPU_FREQ_GOV_INTELLIMM
       tristate "'intelliminmax' cpufreq policy governor"
       help
         To compile this driver as a module, choose M here: the
         module will be called cpufreq_interactive.

         For details, take a look at linux/Documentation/cpu-freq.

         If in doubt, say N.

config CPU_FREQ_GOV_BIOSHOCK
	tristate "'bioshock' cpufreq bioshock"
	depends on CPU_FREQ
	help
	  'bioshock' - More aggressive version of conservative

config CPU_FREQ_GOV_LIONHEART
	tristate "'lionheart' cpufreq governor"
	depends on CPU_FREQ
	help
	  lionheart' - a "smart" optimized governor!
	  If in doubt, say N.

config CPU_FREQ_GOV_SMARTMAX
	tristate "'smartmax' cpufreq governor"
	depends on CPU_FREQ
	help
	  'smartmax' - a "smart" optimized governor!
	  If in doubt, say N.

config CPU_FREQ_GOV_SMARTASS2
	tristate "'smartassV2' cpufreq governor"
	depends on CPU_FREQ
	help
	  'smartassV2' - a "smart" governor

config CPU_FREQ_GOV_IRONACTIVE
	tristate "'ironactive' cpufreq policy governor"
	depends on SCHED_FREQ_INPUT
	help
	  'ironactive' - This driver adds a dynamic cpufreq policy governor

	  This governor attempts to reduce the latency of clock
	  increases so that the system is more responsive to
	  ironactive workloads. Based on 'interactive' governor
	  with many changes compared to our stock 'interactive'
	  governor we have from samsung. Mainly CAF changes.

	  To compile this driver as a module, choose M here: the
	  module will be called cpufreq_ironactive.

	  If in doubt, say N.

config CPU_FREQ_GOV_SMARTMAX_EPS
	tristate "'smartmax EPS' cpufreq policy governor"
	select CPU_FREQ_TABLE
	help
	  'smartmax EPS' is the extreme powersaving version of smartmax

config CPU_FREQ_GOV_ALUCARD
	tristate "'alucard' cpufreq governor"
	depends on CPU_FREQ

config CPU_FREQ_GOV_BLU_ACTIVE
	tristate "'blu_active' cpufreq policy governor"
	help
	  'blu_active' - This driver adds a dynamic cpufreq policy governor
	  interactive workloads.

	  To compile this driver as a module, choose M here: the
	  module will be called cpufreq_blu_active.
	  designed for latency-sensitive workloads.

config CPU_FREQ_GOV_CAFACTIVE
	tristate "'cafactive' cpufreq policy governor"
	help
	  'cafactive' - CodeAurora(Qualcomm) version of interactive
	  cpufreq policy governor.

	  To compile this driver as a module, choose M here: the
	  module will be called cpufreq_cafactive.

	  If in doubt, say N.

config CPU_FREQ_GOV_ELECTRODEMAND
	tristate "'electrodemand' cpufreq policy governor"
        depends on CPU_FREQ
	help
	  'electrodemand' - A tweaked "ondemand" based smart and smooth optimized
           governor designed for optimization in transition and a balance between
           performance and power.
	
	   If in doubt, say N.

config CPU_FREQ_GOV_ONDEMAND_X
	tristate "'ondemand_x' cpufreq policy governor"
	select CPU_FREQ_TABLE
	help
	  'ondemand_x' - This driver adds a dynamic cpufreq policy governor.
	  The governor does a periodic polling and 
	  changes frequency based on the CPU utilization.
	  The support for this governor depends on CPU capability to
	  do fast frequency switching (i.e, very low latency frequency
	  transitions). 

	  To compile this driver as a module, choose M here: the
	  module will be called cpufreq_ondemand_x.

	  For details, take a look at linux/Documentation/cpu-freq.

	  If in doubt, say N.

config CPU_FREQ_GOV_HYPER
	tristate "'HYPER' cpufreq governor"
	depends on CPU_FREQ
	---help---
	  'HYPER' - a tweaked "ondemand" based smart and smooth optimized governor!

	  If in doubt, say Y

config CPU_FREQ_GOV_INTELLIDEMAND
        tristate "'intellidemand' cpufreq policy governor"
        select CPU_FREQ_TABLE
        help
          'intellidemand' - This driver adds a dynamic cpufreq policy governor.
          The governor does a periodic polling and
          changes frequency based on the CPU utilization.
          The support for this governor depends on CPU capability to
          do fast frequency switching (i.e, very low latency frequency
          transitions). with browsing detection based on GPU loading

          To compile this driver as a module, choose M here: the
          module will be called cpufreq_ondemand.

          For details, take a look at linux/Documentation/cpu-freq.

          If in doubt, say N.

config CPU_FREQ_GOV_DESPAIR
	tristate "'despair' cpufreq governor"
	depends on CPU_FREQ
	depends on TOUCHBOOST

config CPU_FREQ_GOV_INTERACTIVE_X
	tristate "'interactive_x' cpufreq policy governor"
	depends on TOUCHBOOST
	help
	  'interactive_x' - This driver adds a dynamic cpufreq policy governor
	  designed for latency-sensitive workloads.

	  This governor attempts to reduce the latency of clock
	  increases so that the system is more responsive to
	  interactive workloads.

	  To compile this driver as a module, choose M here: the
	  module will be called cpufreq_interactive.

	  For details, take a look at linux/Documentation/cpu-freq.

	  If in doubt, say N.

config CPU_FREQ_GOV_CONSERVATIVE_X
	tristate "'conservative_x' cpufreq governor"
	depends on CPU_FREQ
	depends on TOUCHBOOST
	select CPU_FREQ_GOV_COMMON
	help
	  'conservative_x' - this driver is rather similar to the 'ondemand'
	  governor both in its source code and its purpose, the difference is
	  its optimisation for better suitability in a battery powered
	  environment.  The frequency is gracefully increased and decreased
	  rather than jumping to 100% when speed is required.

	  If you have a desktop machine then you should really be considering
	  the 'ondemand' governor instead, however if you are using a laptop,
	  PDA or even an AMD64 based computer (due to the unacceptable
	  step-by-step latency issues between the minimum and maximum frequency
	  transitions in the CPU) you will probably want to use this governor.

	  To compile this driver as a module, choose M here: the
	  module will be called cpufreq_conservative.

	  For details, take a look at linux/Documentation/cpu-freq.

	  If in doubt, say N.

config CPU_FREQ_GOV_INTEREXTREM
	tristate "'interextrem' cpufreq policy governor"
	help
	  'interextrem' - This driver adds a dynamic cpufreq policy governor
	  designed for latency-sensitive workloads.

	  This governor attempts to reduce the latency of clock
	  increases so that the system is more responsive to
	  interactive workloads.

	  To compile this driver as a module, choose M here: the
	  module will be called cpufreq_interextrem.

	  For details, take a look at linux/Documentation/cpu-freq.

	  If in doubt, say N.

config CPUFREQ_DT
	tristate "Generic DT based cpufreq driver"
	depends on HAVE_CLK && OF
	# if CPU_THERMAL is on and THERMAL=m, CPUFREQ_DT cannot be =y:
	depends on !CPU_THERMAL || THERMAL
	select PM_OPP
	help
	  This adds a generic DT based cpufreq driver for frequency management.
	  It supports both uniprocessor (UP) and symmetric multiprocessor (SMP)
	  systems which share clock and voltage across all CPUs.

	  If in doubt, say N.

menu "x86 CPU frequency scaling drivers"
depends on X86
source "drivers/cpufreq/Kconfig.x86"
endmenu

menu "ARM CPU frequency scaling drivers"
depends on ARM || ARM64
source "drivers/cpufreq/Kconfig.arm"
endmenu

menu "AVR32 CPU frequency scaling drivers"
depends on AVR32

config AVR32_AT32AP_CPUFREQ
	bool "CPU frequency driver for AT32AP"
	depends on PLATFORM_AT32AP
	default n
	help
	  This enables the CPU frequency driver for AT32AP processors.
	  If in doubt, say N.

endmenu

menu "CPUFreq processor drivers"
depends on IA64

config IA64_ACPI_CPUFREQ
	tristate "ACPI Processor P-States driver"
	depends on ACPI_PROCESSOR
	help
	This driver adds a CPUFreq driver which utilizes the ACPI
	Processor Performance States.

	For details, take a look at <file:Documentation/cpu-freq/>.

	If in doubt, say N.

endmenu

menu "MIPS CPUFreq processor drivers"
depends on MIPS

config LOONGSON2_CPUFREQ
	tristate "Loongson2 CPUFreq Driver"
	help
	  This option adds a CPUFreq driver for loongson processors which
	  support software configurable cpu frequency.

	  Loongson2F and it's successors support this feature.

	  For details, take a look at <file:Documentation/cpu-freq/>.

	  If in doubt, say N.

endmenu

menu "PowerPC CPU frequency scaling drivers"
depends on PPC32 || PPC64
source "drivers/cpufreq/Kconfig.powerpc"
endmenu

menu "SPARC CPU frequency scaling drivers"
depends on SPARC64
config SPARC_US3_CPUFREQ
	tristate "UltraSPARC-III CPU Frequency driver"
	help
	  This adds the CPUFreq driver for UltraSPARC-III processors.

	  For details, take a look at <file:Documentation/cpu-freq>.

	  If in doubt, say N.

config SPARC_US2E_CPUFREQ
	tristate "UltraSPARC-IIe CPU Frequency driver"
	help
	  This adds the CPUFreq driver for UltraSPARC-IIe processors.

	  For details, take a look at <file:Documentation/cpu-freq>.

	  If in doubt, say N.
endmenu

menu "SH CPU Frequency scaling"
depends on SUPERH
config SH_CPU_FREQ
	tristate "SuperH CPU Frequency driver"
	help
	  This adds the cpufreq driver for SuperH. Any CPU that supports
	  clock rate rounding through the clock framework can use this
	  driver. While it will make the kernel slightly larger, this is
	  harmless for CPUs that don't support rate rounding. The driver
	  will also generate a notice in the boot log before disabling
	  itself if the CPU in question is not capable of rate rounding.

	  For details, take a look at <file:Documentation/cpu-freq>.

	  If unsure, say N.
endmenu

endif
endmenu
```

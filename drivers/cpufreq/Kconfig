## drivers/staging/vnswap/Kconfig
```kconfig
config VNSWAP
	tristate "Fake device for swap"
	depends on BLOCK && SYSFS && (ZSWAP || ESWAP)
	default n
```

## drivers/vision/score/platform/Kconfig
```kconfig
config EXYNOS_SCORE_PLATFORM
	bool "Select Platform"
	select EXYNOS_SCORE_EXYNOS8890
	help
	  This is a selection of platform

config EXYNOS_SCORE_EXYNOS8890
	bool "Use Exynos8890 platform"
	depends on EXYNOS_SCORE_PLATFORM
	help
	  This is a exynos8890 platform
```
